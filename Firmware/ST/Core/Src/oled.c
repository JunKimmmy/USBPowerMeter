#include "oled.h"
#include "main.h"

extern I2C_HandleTypeDef hi2c2;

/* 5×7 bitmap font, ASCII 0x20–0x7E, one byte per column */
const uint8_t font5x7[95][5] = {
    {0x00,0x00,0x00,0x00,0x00}, /* 0x20   */
    {0x00,0x00,0x5F,0x00,0x00}, /* 0x21 ! */
    {0x00,0x07,0x00,0x07,0x00}, /* 0x22 " */
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    {0x10,0x08,0x08,0x10,0x08}, /* 0x7E ~ */
};

static void send_cmd(uint8_t cmd)
{
    uint8_t buf[2] = {0x00, cmd};
    HAL_I2C_Master_Transmit(&hi2c2, OLED_I2C_ADDR, buf, 2, 10);
}

static void send_cmds(const uint8_t *cmds, uint8_t len)
{
    uint8_t buf[32];
    buf[0] = 0x00;
    for (uint8_t i = 0; i < len && i < 31; i++)
        buf[i + 1] = cmds[i];
    HAL_I2C_Master_Transmit(&hi2c2, OLED_I2C_ADDR, buf, len + 1, 50);
}

void OLED_SetCursor(uint8_t page, uint8_t col)
{
    uint8_t cmds[3] = {
        0xB0 | (page & 0x07),
        0x00 | (col & 0x0F),
        0x10 | (col >> 4)
    };
    send_cmds(cmds, 3);
}

void OLED_Clear(void)
{
    uint8_t buf[129];
    buf[0] = 0x40;
    for (uint8_t i = 1; i < 129; i++)
        buf[i] = 0x00;

    for (uint8_t page = 0; page < 8; page++)
    {
        OLED_SetCursor(page, 0);
        HAL_I2C_Master_Transmit(&hi2c2, OLED_I2C_ADDR, buf, 129, 50);
    }
}

void OLED_Fill(uint8_t pattern)
{
    uint8_t buf[129];
    buf[0] = 0x40;
    for (uint8_t i = 1; i < 129; i++)
        buf[i] = pattern;

    for (uint8_t page = 0; page < 8; page++)
    {
        OLED_SetCursor(page, 0);
        HAL_I2C_Master_Transmit(&hi2c2, OLED_I2C_ADDR, buf, 129, 50);
    }
}

void OLED_ClearLine(uint8_t page)
{
    uint8_t buf[129];
    buf[0] = 0x40;
    for (uint8_t i = 1; i < 129; i++) buf[i] = 0x00;
    OLED_SetCursor(page, 0);
    HAL_I2C_Master_Transmit(&hi2c2, OLED_I2C_ADDR, buf, 129, 50);
}

void OLED_WriteChar(uint8_t page, uint8_t col, char c)
{
    if ((uint8_t)c < 0x20 || (uint8_t)c > 0x7E) c = ' ';
    uint8_t buf[7];
    buf[0] = 0x40;
    for (uint8_t i = 0; i < 5; i++)
        buf[i + 1] = font5x7[(uint8_t)c - 0x20][i];
    buf[6] = 0x00;
    OLED_SetCursor(page, col);
    HAL_I2C_Master_Transmit(&hi2c2, OLED_I2C_ADDR, buf, 7, 20);
}

void OLED_WriteString(uint8_t page, uint8_t col, const char *str)
{
    while (*str && col <= 122)
    {
        OLED_WriteChar(page, col, *str++);
        col += 6;
    }
}

HAL_StatusTypeDef OLED_Init(void)
{
    /* 1. Hold RESET low while powering on */
    HAL_GPIO_WritePin(OLED_RESET_GPIO_Port, OLED_RESET_Pin, GPIO_PIN_RESET);
    HAL_GPIO_WritePin(OLED_POWER_EN_GPIO_Port, OLED_POWER_EN_Pin, GPIO_PIN_SET);
    HAL_Delay(100);  /* let VCC stabilise */

    /* 2. Release reset */
    HAL_GPIO_WritePin(OLED_RESET_GPIO_Port, OLED_RESET_Pin, GPIO_PIN_SET);
    HAL_Delay(10);

    /* 3. Confirm the display ACKs on I2C before sending commands */
    if (HAL_I2C_IsDeviceReady(&hi2c2, OLED_I2C_ADDR, 5, 200) != HAL_OK)
        return HAL_ERROR;

    /* 4. Init sequence — SSD1315 §4.4.2, internal charge pump */
    static const uint8_t init[] = {
        0xAE,        /* display off                     */
        0xA8, 0x3F,  /* multiplex ratio 1/64            */
        0xD3, 0x00,  /* display offset = 0              */
        0x40,        /* display start line = 0          */
        0xA1,        /* segment re-map col127->SEG0     */
        0xC8,        /* COM scan direction remapped     */
        0xDA, 0x12,  /* COM pins hardware config        */
        0x81, 0xFF,  /* max contrast                    */
        0xA4,        /* output follows RAM              */
        0xA6,        /* normal (non-inverted) display   */
        0xD5, 0x80,  /* clock: max freq, no divide      */
        0xD9, 0xF1,  /* pre-charge period               */
        0xDB, 0x30,  /* VCOMH deselect level            */
        0x8D, 0x14,  /* enable internal charge pump     */
    };
    send_cmds(init, sizeof(init));

    /* 5. Clear RAM, wait for charge pump to settle, turn on */
    OLED_Clear();
    HAL_Delay(100);
    send_cmd(0xAF);  /* display ON */

    return HAL_OK;
}
